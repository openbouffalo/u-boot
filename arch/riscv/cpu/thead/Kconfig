## arch/riscv/cpu/thead/Kconfig
```kconfig
# SPDX-License-Identifier: GPL-2.0+

config THEAD_C906
	bool

config THEAD_E906
	bool
```

## board/bflb/bl808/Kconfig
```kconfig
if TARGET_BFLB_BL808

config BL808_CPU_D0
	def_bool ARCH_RV64I
	select THEAD_C906

config BL808_CPU_M0
	def_bool ARCH_RV32I
	select THEAD_E906

config BOARD_SPECIFIC_OPTIONS # dummy
	def_bool y
	select BOARD_EARLY_INIT_F
	select DM_GPIO if GPIO
	select GENERIC_RISCV
	select OF_HAS_PRIOR_STAGE if RISCV_SMODE
	imply RISCV_TIMER

config SYS_BOARD
	default "bl808"

config SYS_CONFIG_NAME
	default "bl808"

config SYS_CPU
	default "thead"

config SYS_LOAD_ADDR
	default 0x50100000

config SYS_VENDOR
	default "bflb"

config TEXT_BASE
	default 0x58000000 if XIP
	default 0x50100000 if BL808_CPU_D0
	default 0x22020000 if BL808_CPU_M0

endif
```

## configs/ox64_d0_defconfig
```kconfig
CONFIG_RISCV=y
CONFIG_NR_DRAM_BANKS=1
CONFIG_DEFAULT_DEVICE_TREE="bl808-d0-ox64"
CONFIG_DM_RESET=y
CONFIG_TARGET_BFLB_BL808=y
CONFIG_ARCH_RV64I=y
CONFIG_RISCV_SMODE=y
CONFIG_DISTRO_DEFAULTS=y
# CONFIG_SYS_MALLOC_CLEAR_ON_INIT is not set
CONFIG_DYNAMIC_SYS_CLK_FREQ=y
CONFIG_CMD_CLK=y
CONFIG_CMD_GPIO=y
CONFIG_CMD_MMC=y
CONFIG_NET_RANDOM_ETHADDR=y
CONFIG_MMC=y
CONFIG_MMC_BROKEN_CD=y
CONFIG_MMC_SDHCI=y
CONFIG_MMC_SDHCI_BFLB=y
CONFIG_PHYLIB=y
CONFIG_ETHOC=y
CONFIG_PINCTRL=y
CONFIG_PINCONF=y
# CONFIG_PINCONF_RECURSIVE is not set
CONFIG_SYSRESET=y
```

## configs/ox64_m0_defconfig
```kconfig
CONFIG_RISCV=y
CONFIG_SYS_MALLOC_LEN=0x10000
CONFIG_NR_DRAM_BANKS=1
CONFIG_ENV_SIZE=0x1000
CONFIG_DEFAULT_DEVICE_TREE="bl808-m0-ox64"
CONFIG_DM_RESET=y
CONFIG_TARGET_BFLB_BL808=y
CONFIG_XIP=y
# CONFIG_SYS_MALLOC_CLEAR_ON_INIT is not set
CONFIG_REMAKE_ELF=y
# CONFIG_BOOTSTD is not set
# CONFIG_LEGACY_IMAGE_FORMAT is not set
CONFIG_SUPPORT_RAW_INITRD=y
CONFIG_DYNAMIC_SYS_CLK_FREQ=y
# CONFIG_ARCH_FIXUP_FDT_MEMORY is not set
# CONFIG_AUTOBOOT is not set
CONFIG_HUSH_PARSER=y
# CONFIG_CMD_BDI is not set
# CONFIG_CMD_CONSOLE is not set
# CONFIG_CMD_CPU is not set
# CONFIG_CMD_BOOTD is not set
# CONFIG_CMD_BOOTM is not set
# CONFIG_CMD_ELF is not set
# CONFIG_CMD_FDT is not set
# CONFIG_CMD_IMI is not set
# CONFIG_CMD_XIMG is not set
# CONFIG_CMD_EXPORTENV is not set
# CONFIG_CMD_IMPORTENV is not set
# CONFIG_CMD_EDITENV is not set
# CONFIG_CMD_SAVEENV is not set
# CONFIG_CMD_ENV_EXISTS is not set
# CONFIG_CMD_LZMADEC is not set
# CONFIG_CMD_UNLZ4 is not set
# CONFIG_CMD_UNZIP is not set
CONFIG_CMD_CLK=y
CONFIG_CMD_GPIO=y
CONFIG_CMD_MMC=y
CONFIG_CMD_REMOTEPROC=y
CONFIG_CMD_DHCP=y
CONFIG_CMD_FS_GENERIC=y
CONFIG_DOS_PARTITION=y
CONFIG_EFI_PARTITION=y
CONFIG_NET_RANDOM_ETHADDR=y
# CONFIG_DM_STDIO is not set
# CONFIG_I2C is not set
# CONFIG_INPUT is not set
CONFIG_MMC=y
CONFIG_MMC_BROKEN_CD=y
CONFIG_MMC_SDHCI=y
CONFIG_MMC_SDHCI_BFLB=y
# CONFIG_MTD is not set
CONFIG_SPI_FLASH_WINBOND=y
CONFIG_ETHOC=y
CONFIG_PINCTRL=y
# CONFIG_PINCONF_RECURSIVE is not set
# CONFIG_POWER is not set
CONFIG_RAM=y
# CONFIG_RAM_SIFIVE is not set
CONFIG_REMOTEPROC_BFLB=y
CONFIG_SPI=y
CONFIG_SYSRESET=y
CONFIG_FS_EXT4=y
CONFIG_FS_FAT=y
# CONFIG_GZIP is not set
# CONFIG_EFI_LOADER is not set
```
